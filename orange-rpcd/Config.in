## orange-rpcd/Config.in
```kconfig
config ORANGE_PARALLEL
	depends on PACKAGE_orange-rpcd
	bool "Enable parallel processing of requests"
	default y
	select KERNEL_LXC_MISC
	select KERNEL_POSIX_MQUEUE

config ORANGE_RPC_OPTION_SHA1
	bool "Enable SHA1 password encryption"
	default y
	select BUSYBOX_DEFAULT_SHA1SUM
	help
	  Add SHA1SUM support in BusyBox. Required for storing passwords
```
